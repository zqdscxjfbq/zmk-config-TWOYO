## config/boards/shields/J64/Kconfig.defconfig
```kconfig
if SHIELD_J64

config ZMK_KEYBOARD_NAME
	default "Jacob's 64"

config ZMK_KSCAN_DIRECT_POLLING
	default y
endif
```

## config/boards/shields/J64/Kconfig.shield
```kconfig
# Copyright (c) 2020 Nick Winans
# SPDX-License-Identifier: MIT

config SHIELD_J64
	def_bool $(shields_list_contains,j64)
```

## config/boards/shields/M0110A/Kconfig.defconfig
```kconfig
if SHIELD_M0110A

config ZMK_KEYBOARD_NAME
	default "M0110A"

config ZMK_KSCAN_DIRECT_POLLING
	default y
endif
```

## config/boards/shields/M5120/Kconfig.defconfig
```kconfig
if SHIELD_APPLE

config ZMK_KEYBOARD_NAME
	default "apple?"

config ZMK_KSCAN_DIRECT_POLLING
	default y
endif
```

## config/boards/shields/M5120/Kconfig.shield
```kconfig
# Copyright (c) 2020 Nick Winans
# SPDX-License-Identifier: MIT

config SHIELD_APPLE
	def_bool $(shields_list_contains,apple)
```

## config/boards/shields/bdn9/Kconfig.defconfig
```kconfig
if SHIELD_BDN9

config ZMK_KEYBOARD_NAME
	default "BDN9"

config ZMK_KSCAN_DIRECT_POLLING
	default y
	
endif
```

## config/boards/shields/lily58c/Kconfig.shield
```kconfig
# Copyright (c) 2020 Pete Johanson
# SPDX-License-Identifier: MIT

config SHIELD_LILY58C_LEFT
	def_bool $(shields_list_contains,lily58c_left)

config SHIELD_LILY58C_RIGHT
	def_bool $(shields_list_contains,lily58c_right)
```

## config/boards/shields/yeehaw/Kconfig.defconfig
```kconfig
if SHIELD_YEEHAW

config ZMK_KEYBOARD_NAME
	default "YEEHAW"

config ZMK_KSCAN_DIRECT_POLLING
	default y
	
endif
```
